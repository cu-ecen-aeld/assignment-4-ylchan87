## base_external/package/aesd-assignments/Config.in
```kconfig
config BR2_PACKAGE_AESD_ASSIGNMENTS
	bool "aesd-assignments"
	help
	  Includes the writer executable, finder.sh and tester.sh in the kernel image.
	  Used to understand buildroot external trees and package builds.


config BR2_PACKAGE_AESD_ASSIGNMENTS_DUMMY_INT
	int "aesd-assignments-dummy-int"
	help
	  a dummy int with no use for test setting vars in build
```
